## applications/thread_border_router/src/net/Kconfig.defaults
```kconfig
#
# Copyright (c) 2024 Nordic Semiconductor
#
# SPDX-License-Identifier: LicenseRef-Nordic-5-Clause
#

config NET_BUF_POOL_USAGE
    default y
```

## applications/thread_border_router/tests/mdns/testcase.yaml
```yaml
tests:
  nrf_tbr.mdns:
    platform_allow: native_posix
    integration_platforms:
      - native_posix
    tags: nrf_tbr_mdns
```

## samples/crypto/aes_gcm/boards/nrf54l15dk_nrf54l15_cpuapp.conf
```kconfig
CONFIG_PSA_CRYPTO_DRIVER_OBERON=y

# Note that we are turning off the AEAD driver and not the CRACEN
# driver as a whole because we wish to specifically test AEAD with
# Oberon, but still need the CRACEN driver for PRNG/TRNG.
CONFIG_PSA_USE_CRACEN_AEAD_DRIVER=n
```

## samples/ipc/ipc_service/dts/bindings/interdomain-timer.yaml
```yaml
# Copyright (c) 2023 Nordic Semiconductor ASA
# SPDX-License-Identifier: LicenseRef-Nordic-5-Clause

description: Select IPCT channel to be used by the application

compatible: "interdomain-timer"

properties:
  ipct-stop:
    type: phandle
    description: |
      The IPCT instance used to stop the timer.
      The timer that is stopped holds its last value.
      Stopping the timer via IPCT does not clear it.
      Optional parameter: if present - the timer can be stopped by remote domain.

  ipct-ch-stop:
    type: int
    description: |
      The IPCT channel used to stop the timer.

  ipct-start:
    type: phandle
    description: |
      The IPCT instance used to start the timer.
      Optional parameter: if present - the timer can be started by remote domain.

  ipct-ch-start:
    type: int
    description: |
      The IPCT channel used to start the timer.

  timer:
    type: phandle
    required: true
    description: |
      The timer used to measure the lattency.
```

## samples/ipc/ipc_service/dts/bindings/ipct-channel.yaml
```yaml
# Copyright (c) 2023 Nordic Semiconductor ASA
# SPDX-License-Identifier: LicenseRef-Nordic-5-Clause

description: Select IPCT channel to be used by the application

compatible: "ipct-channel"

properties:
  ipct:
    type: phandle
    required: true
    description: |
      The IPCT instance to be used.

  ch:
    type: int
    required: true
    description: |
      The IPCT channel to be used.
```

## samples/ipc/ipc_service/modules/Kconfig
```kconfig
#
# Copyright (c) 2023 Nordic Semiconductor ASA
#
# SPDX-License-Identifier: LicenseRef-Nordic-5-Clause
#
DT_COMPAT_INTERDOMAIN_TIMER := interdomain-timer

menuconfig INTERDOMAIN_TIMER
	bool "Interdomain timer"
	default y if $(dt_compat_enabled,$(DT_COMPAT_INTERDOMAIN_TIMER))
	help
	  Enable interdomain timer that allows starting or stopping the timer via IPCT channels.

if INTERDOMAIN_TIMER

config IDTIMER_INIT_PRIORITY
	int "Interdomain timer init priority"
	default 70
	help
	  Interdomain driver device initialization priority.
	  It should be initialized after the counter driver.

module = INTERDOMAIN_TIMER
module-str = id timer
source "subsys/logging/Kconfig.template.log_config"

endif #INTERDOMAIN_TIMER
```

## samples/ipc/ipc_service/remote/boards/nrf54h20_latency_timers.conf
```kconfig
#
# Copyright (c) 2023 Nordic Semiconductor ASA
#
# SPDX-License-Identifier: LicenseRef-Nordic-5-Clause
#

CONFIG_COUNTER=y
CONFIG_NRFX_TIMER130=y
CONFIG_NRFX_PPIB=y

CONFIG_APP_IPC_SERVICE_SEND_INTERVAL=500000
CONFIG_LOG_PROCESS_THREAD_PRIORITY=0
```

## tests/subsys/suit/storage_nrf54h20/testcase.yaml
```yaml
tests:
  suit-processor.integration.suit_storage_nrf54h20:
    platform_allow: native_posix
    tags: suit-processor suit_storage
    integration_platforms:
      - native_posix

  suit-processor.integration.suit_storage_nrf54h20.fpga:
    platform_allow: nrf54h20dk_nrf54h20_cpusec@soc1
    tags: suit-processor suit_storage fpga
    timeout: 240
    extra_args: DTC_OVERLAY_FILE=boards/nrf54h20dk_nrf54h20_cpusec.overlay;serial_cpusec.overlay;systick.overlay
    extra_configs:
      - CONFIG_EMULATOR_FPGA=y
```
